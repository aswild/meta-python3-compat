## conf/layer.conf
```bitbake
# append to BBPATH
BBPATH .= ":${LAYERDIR}"

BBFILES += "${LAYERDIR}/recipes*/*/*.bb \
            ${LAYERDIR}/recipes*/*/*.bbappend"

BBFILE_COLLECTIONS += "python3compat"
BBFILE_PATTERN_python3compat := "^${LAYERDIR}/"
BBFILE_PRIORITY_python3compat = "11"
```
